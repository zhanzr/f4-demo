/**
  * @file    wifi_http_server/src/http_server.c
  * @brief   lwIP raw-API HTTP server for the bundled single-page site.
  *
  * Serves the single-page app (gzip, CSS/JS inlined, from src/web_assets.h,
  * generated by e_server/build_web.py from e_server/web/ + e_server/public/)
  * plus the JSON API, mirroring the e_server reference backend:
  *
  *   GET  /                 page, Content-Encoding: gzip
  *   GET  /api/leds         {"leds":[0]}       (real LED GPIO state)
  *   POST /api/leds         body {"leds":[0]}  -> applies to the LED
  *   GET  /api/adc          {"vrefint_mv":..,"temp_c":..,"vbat_v":..,
  *                           "motion_x":..,"motion_y":..,"motion_z":..,
  *                           "dht11_t":..,"dht11_h":..,"ts":..}
  *   GET  /api/camera       {"source":"dvi","ready":0,"ts":..}  (placeholder)
  *   GET  /api/info         {"arch","lan_ip","public_ip":null,"geo":null,
  *                           "weather":null}
  *   GET  /public/<name>    raw image bytes (from the embedded_files[] table)
  *
  * The public IP / geo / weather fields are reported as null (the page shows
  * "N/A") because the board has no HTTP/TLS client; see the README for what
  * an HTTPS client would require.
  *
  * Responses are paced through tcp_sent: static bodies (page/images) are
  * written from flash without copying, JSON is built into the per-connection
  * buffer. NO_SYS / raw API - all callbacks run in the main loop while
  * ethernetif_input() is polled.
  */

#include "stm32f4xx_hal.h"
#include "lwip/opt.h"
#include "lwip/tcp.h"
#include "lwip/mem.h"
#include "lwip/timeouts.h"
#include "lwip/ip_addr.h"
#include "lwip/netif.h"
#include "http_server.h"
#include "web_assets.h"
#include "board.h"
#include "adc_internal.h"
#include "dht11.h"
#include "mpu6050.h"
#include "ov5640.h"

#include <stdio.h>
#include <stdlib.h>
#include <string.h>

extern struct netif gnetif;

/* --------------------------------------------------------------------------
 * On-board LED (LED_1, PD12 - low active).
 * ------------------------------------------------------------------------ */
#define LED_PORT  GPIOD
#define LED_PIN   GPIO_PIN_12

static void leds_init(void)
{
    GPIO_InitTypeDef gpio = {0};

    __HAL_RCC_GPIOD_CLK_ENABLE();

    gpio.Mode  = GPIO_MODE_OUTPUT_PP;
    gpio.Pull  = GPIO_NOPULL;
    gpio.Speed = GPIO_SPEED_FREQ_LOW;
    gpio.Pin   = LED_PIN;
    HAL_GPIO_Init(LED_PORT, &gpio);
}

static int led_get(int i)
{
    (void)i;
    return HAL_GPIO_ReadPin(LED_PORT, LED_PIN) == GPIO_PIN_RESET;  /* low = on */
}

static void led_set(int i, int on)
{
    (void)i;
    HAL_GPIO_WritePin(LED_PORT, LED_PIN, on ? GPIO_PIN_RESET : GPIO_PIN_SET);
}

/* --------------------------------------------------------------------------
 * Internal ADC channels (die temperature / VREFINT / VBAT) + the on-board
 * sensors (DHT11 on PE2, MPU6050 on I2C1), the same as board_hello.
 * ------------------------------------------------------------------------ */
#define VREFINT_TYPICAL_MV   1210U

/* Factory temperature-sensor calibration (12-bit, VDDA = 3.3 V):
 *   TS_CAL1 @ 0x1FFF7A2C  ->  30 C
 *   TS_CAL2 @ 0x1FFF7A2E  -> 110 C        */
#define TS_CAL1_ADDR  ((uint16_t *)0x1FFF7A2CU)
#define TS_CAL2_ADDR  ((uint16_t *)0x1FFF7A2EU)

static int TempC_FromCode(uint32_t raw_temp, uint32_t vdda_mv)
{
    uint32_t cal1 = *TS_CAL1_ADDR;
    uint32_t cal2 = *TS_CAL2_ADDR;

    if (cal1 == 0U || cal2 <= cal1)
    {
        return 0;   /* no valid calibration data */
    }
    uint32_t adc_scaled = (raw_temp * 3300UL) / vdda_mv;
    if (adc_scaled <= cal1)
    {
        return 30;
    }
    if (adc_scaled >= cal2)
    {
        return 110;
    }
    return 30 + (int)((adc_scaled - cal1) * 80UL / (cal2 - cal1));
}

static void sensors_init(void)
{
    ADC_Internal_Init();
    DHT11_Init();
    if (MPU6050_Init())
    {
        printf("MPU6050: ready (I2C1)\r\n");
    }
    else
    {
        printf("MPU6050: not detected (I2C1)\r\n");
    }
}

/* --------------------------------------------------------------------------
 * TCP connection state + response pacing.
 * ------------------------------------------------------------------------ */
#define HTTP_RX_BUF   1024
#define HTTP_RESP_BUF 512

struct http_conn
{
  struct tcp_pcb *pcb;
  char rx[HTTP_RX_BUF];          /* accumulated request */
  size_t rx_len;
  char resp[HTTP_RESP_BUF];      /* header (+ JSON body) */
  size_t hdr_len;
  const uint8_t *body_ptr;       /* static body (page / image) or NULL */
  size_t body_len;
  u8_t body_static;              /* body_ptr points into const flash */
  size_t total_off;              /* bytes of response queued to lwIP */
  u8_t done;                     /* whole response queued */
};

static err_t http_recv(void *arg, struct tcp_pcb *pcb, struct pbuf *p, err_t err);
static err_t http_sent(void *arg, struct tcp_pcb *pcb, u16_t len);
static void  http_err(void *arg, err_t err);

/* Queue as much of the response as fits; the rest is sent from tcp_sent. */
static void conn_send(struct http_conn *c)
{
  for (;;)
  {
    const uint8_t *ptr;
    size_t left;
    u8_t flags;

    if (c->total_off < c->hdr_len)
    {
      ptr   = (const uint8_t *)c->resp + c->total_off;
      left  = c->hdr_len - c->total_off;
      flags = TCP_WRITE_FLAG_COPY;   /* header is in the per-conn buffer */
    }
    else
    {
      size_t bo = c->total_off - c->hdr_len;
      if (bo >= c->body_len)
      {
        c->done = 1;
        break;
      }
      ptr   = c->body_ptr + bo;
      left  = c->body_len - bo;
      flags = c->body_static ? 0 : TCP_WRITE_FLAG_COPY;
    }

    {
      u16_t chunk = (u16_t)LWIP_MIN(left, 2048);
      if (tcp_write(c->pcb, ptr, chunk, flags) != ERR_OK) break;
      c->total_off += chunk;
    }
  }
  tcp_output(c->pcb);
}

/* Close and free the connection once the response is fully queued. */
static void http_conn_close(struct http_conn *c)
{
  err_t err = tcp_close(c->pcb);
  if (err == ERR_OK)
  {
    tcp_arg(c->pcb, NULL);
    tcp_recv(c->pcb, NULL);
    tcp_sent(c->pcb, NULL);
    tcp_err(c->pcb, NULL);
    mem_free(c);
  }
  /* else: retried from tcp_sent when the send buffer drains */
}

static void http_reply_json(struct http_conn *c, const char *body)
{
  int n = snprintf(c->resp, sizeof(c->resp),
                   "HTTP/1.1 200 OK\r\n"
                   "Content-Type: application/json; charset=utf-8\r\n"
                   "Content-Length: %u\r\n"
                   "Cache-Control: no-store\r\n"
                   "Connection: close\r\n"
                   "\r\n"
                   "%s",
                   (unsigned)strlen(body), body);
  c->hdr_len = (size_t)n;
  c->body_ptr = NULL;
  c->body_len = 0;
  c->body_static = 0;
  c->total_off = 0;
  c->done = 0;
  conn_send(c);
  if (c->done) http_conn_close(c);
}

static void http_reply_err(struct http_conn *c, int code, const char *status)
{
  int n = snprintf(c->resp, sizeof(c->resp),
                   "HTTP/1.1 %d %s\r\n"
                   "Content-Type: text/plain\r\n"
                   "Content-Length: 0\r\n"
                   "Cache-Control: no-store\r\n"
                   "Connection: close\r\n"
                   "\r\n",
                   code, status);
  c->hdr_len = (size_t)n;
  c->body_ptr = NULL;
  c->body_len = 0;
  c->body_static = 0;
  c->total_off = 0;
  c->done = 0;
  conn_send(c);
  if (c->done) http_conn_close(c);
}

static void http_reply_static(struct http_conn *c, const char *ctype,
                              const char *encoding,
                              const uint8_t *data, size_t len)
{
  int n = snprintf(c->resp, sizeof(c->resp),
                   "HTTP/1.1 200 OK\r\n"
                   "Content-Type: %s\r\n"
                   "%s"
                   "Content-Length: %lu\r\n"
                   "Cache-Control: no-store\r\n"
                   "Connection: close\r\n"
                   "\r\n",
                   ctype,
                   encoding ? encoding : "",
                   (unsigned long)len);
  c->hdr_len = (size_t)n;
  c->body_ptr = data;
  c->body_len = len;
  c->body_static = 1;
  c->total_off = 0;
  c->done = 0;
  conn_send(c);
  if (c->done) http_conn_close(c);
}

/* --------------------------------------------------------------------------
 * API handlers.
 * ------------------------------------------------------------------------ */
static void api_leds(struct http_conn *c, const char *method, const char *body)
{
  if (strcmp(method, "POST") == 0 && body)
  {
    const char *b = strchr(body, '[');
    if (b)
    {
      int a[1] = { 0 };
      int got = sscanf(b + 1, "%d", &a[0]);
      for (int i = 0; i < got && i < 1; i++) led_set(i, a[i] ? 1 : 0);
    }
  }

  char resp[64];
  int n = snprintf(resp, sizeof(resp), "{\"leds\":[%d]}", led_get(0));
  http_reply_json(c, resp);
}

static void api_adc(struct http_conn *c)
{
  ADC_InternalResult adc;
  MPU6050_Data mpu;
  DHT11_Result dht;
  char body[320];
  uint32_t vdda_mv = 0;
  int temp_c = 0;
  uint32_t vbat_mv = 0;
  float m_x = 0, m_y = 0, m_z = 0;
  float d_t = 0, d_h = 0;

  ADC_Internal_Sample(&adc);
  if (adc.raw_vrefint != 0U)
  {
    vdda_mv = (VREFINT_TYPICAL_MV * 4095UL) / adc.raw_vrefint;
  }
  temp_c = TempC_FromCode(adc.raw_temp, vdda_mv);
  if (adc.raw_vbat != 0U)
  {
    vbat_mv = (vdda_mv * adc.raw_vbat) / 4095UL * 3UL;
  }

  if (MPU6050_Read(&mpu))
  {
    m_x = (float)mpu.ax / 8192.0f;   /* +/-4g -> 8192 LSB/g */
    m_y = (float)mpu.ay / 8192.0f;
    m_z = (float)mpu.az / 8192.0f;
  }

  if (DHT11_Read(&dht) && dht.valid)
  {
    d_t = (float)dht.t_int + (float)dht.t_dec / 10.0f;
    d_h = (float)dht.rh_int + (float)dht.rh_dec / 10.0f;
  }

  int n = snprintf(body, sizeof(body),
                   "{\"vrefint_mv\":%.1f,\"temp_c\":%.1f,\"vbat_v\":%.2f,"
                   "\"motion_x\":%.3f,\"motion_y\":%.3f,\"motion_z\":%.3f,"
                   "\"dht11_t\":%.1f,\"dht11_h\":%.1f,\"ts\":%lu}",
                   (double)vdda_mv, (double)temp_c, (double)vbat_mv / 1000.0,
                   (double)m_x, (double)m_y, (double)m_z,
                   (double)d_t, (double)d_h, (unsigned long)HAL_GetTick());
  http_reply_json(c, body);
}

/* GET /api/camera: OV5640 status (matches e_server). */
static void api_camera(struct http_conn *c)
{
  char body[96];
  int n = snprintf(body, sizeof(body),
                   "{\"source\":\"ov5640-rgb565\",\"ready\":%d,"
                   "\"w\":%d,\"h\":%d,\"frames\":%lu,\"ts\":%lu}",
                   OV5640_Ready() ? 1 : 0,
                   (int)OV5640_FRAME_W, (int)OV5640_FRAME_H,
                   (unsigned long)OV5640_FrameCount(),
                   (unsigned long)HAL_GetTick());
  http_reply_json(c, body);
}

/* --------------------------------------------------------------------------
 * RGB565 -> 24-bit BMP (universally renderable in browsers; Chrome/Firefox
 * do not render 16-bit BMP, so we convert to 24-bit RGB).
 * ------------------------------------------------------------------------ */
#define BMP_HDR_LEN  54
#define BMP_STRIDE   (OV5640_FRAME_W * 3U)                      /* 480 */
#define BMP_IMG_SIZE (BMP_STRIDE * OV5640_FRAME_H)              /* 57600 */
#define BMP_TOT_SIZE (BMP_HDR_LEN + BMP_IMG_SIZE)               /* 57654 */

static uint8_t bmp_rgb[BMP_TOT_SIZE];   /* 54-byte header + 24-bit pixels */

/* Build a 24-bit BMP header (top-down rows, no padding). */
static void bmp_header(uint8_t *h)
{
  memset(h, 0, BMP_HDR_LEN);
  h[0] = 'B'; h[1] = 'M';
  h[2] = (uint8_t)(BMP_TOT_SIZE & 0xFF);       h[3] = (uint8_t)((BMP_TOT_SIZE >> 8) & 0xFF);
  h[4] = (uint8_t)((BMP_TOT_SIZE >> 16) & 0xFF); h[5] = (uint8_t)((BMP_TOT_SIZE >> 24) & 0xFF);
  h[10] = BMP_HDR_LEN;
  h[14] = 40;                       /* BITMAPINFOHEADER size */
  h[18] = (uint8_t)(OV5640_FRAME_W & 0xFF); h[19] = (uint8_t)(OV5640_FRAME_W >> 8);
  /* negative height = top-down */
  {
    uint32_t nh = (uint32_t)(-(int32_t)OV5640_FRAME_H);
    h[22] = (uint8_t)(nh & 0xFF); h[23] = (uint8_t)((nh >> 8) & 0xFF);
    h[24] = (uint8_t)((nh >> 16) & 0xFF); h[25] = (uint8_t)((nh >> 24) & 0xFF);
  }
  h[26] = 1;                        /* planes */
  h[28] = 24;                       /* bitcount */
  h[34] = (uint8_t)(BMP_IMG_SIZE & 0xFF); h[35] = (uint8_t)((BMP_IMG_SIZE >> 8) & 0xFF);
  h[36] = (uint8_t)((BMP_IMG_SIZE >> 16) & 0xFF); h[37] = (uint8_t)((BMP_IMG_SIZE >> 24) & 0xFF);
}

/* Convert one RGB565 frame (from the DMA ring) into the 24-bit BGR buffer.
 * Returns the total bytes of the BMP (header + pixels). */
static uint32_t frame_to_bmp(const uint8_t *frame, uint8_t *out)
{
  const uint16_t *p = (const uint16_t *)frame;
  uint8_t *d = out + BMP_HDR_LEN;
  uint32_t n;

  bmp_header(out);

  for (n = 0; n < OV5640_FRAME_W * OV5640_FRAME_H; n++)
  {
    uint16_t v = p[n];
    uint8_t r5 = (uint8_t)((v >> 11) & 0x1F);   /* standard 565 (vendor) */
    uint8_t g6 = (uint8_t)((v >> 5)  & 0x3F);
    uint8_t b5 = (uint8_t)(v & 0x1F);
    *d++ = (uint8_t)((b5 << 3) | (b5 >> 2));   /* B */
    *d++ = (uint8_t)((g6 << 2) | (g6 >> 4));   /* G */
    *d++ = (uint8_t)((r5 << 3) | (r5 >> 2));   /* R */
  }
  return BMP_TOT_SIZE;
}

/* --------------------------------------------------------------------------
 * MJPEG stream (multipart/x-mixed-replace, image/bmp parts).
 * ------------------------------------------------------------------------ */
#define STREAM_BOUNDARY  "firef429mjpeg"

static struct tcp_pcb *g_stream_pcb;   /* active MJPEG stream, or NULL */

static void stream_close(void)
{
  if (g_stream_pcb)
  {
    tcp_arg(g_stream_pcb, NULL);
    tcp_recv(g_stream_pcb, NULL);
    tcp_sent(g_stream_pcb, NULL);
    tcp_err(g_stream_pcb, NULL);
    tcp_close(g_stream_pcb);
    g_stream_pcb = NULL;
  }
}

static err_t stream_recv(void *arg, struct tcp_pcb *pcb, struct pbuf *p, err_t err)
{
  (void)arg;
  if (err != ERR_OK) return ERR_OK;
  if (p == NULL)
  {
    stream_close();   /* client went away */
    return ERR_OK;
  }
  tcp_recved(pcb, p->tot_len);
  pbuf_free(p);
  return ERR_OK;
}

static void stream_err(void *arg, err_t err)
{
  (void)arg;
  (void)err;
  g_stream_pcb = NULL;
}

/* GET /stream: convert this connection into the live MJPEG stream. */
static void api_stream(struct http_conn *c)
{
  struct tcp_pcb *pcb = c->pcb;
  char hdr[192];
  int hn;

  if (!OV5640_Ready())
  {
    http_reply_err(c, 503, "Service Unavailable");
    return;
  }
  if (g_stream_pcb != NULL)
  {
    http_reply_err(c, 503, "Service Unavailable");   /* one stream only */
    return;
  }

  /* Detach the http_conn bookkeeping; we manage the pcb directly now. */
  tcp_arg(pcb, NULL);
  tcp_recv(pcb, stream_recv);
  tcp_sent(pcb, NULL);
  tcp_err(pcb, stream_err);
  mem_free(c);

  hn = snprintf(hdr, sizeof(hdr),
                "HTTP/1.1 200 OK\r\n"
                "Content-Type: multipart/x-mixed-replace; boundary=%s\r\n"
                "Cache-Control: no-store\r\n"
                "Connection: close\r\n"
                "\r\n"
                "--%s\r\n", STREAM_BOUNDARY, STREAM_BOUNDARY);
  tcp_write(pcb, hdr, (u16_t)hn, TCP_WRITE_FLAG_COPY);

  g_stream_pcb = pcb;
  tcp_output(pcb);
}

/* GET /capture: a single BMP frame. */
static void api_capture(struct http_conn *c)
{
  const uint8_t *frame;
  uint32_t len;

  if (OV5640_Ready())
  {
    /* The main loop health watchdog (http_stream_poll) keeps the sensor
     * alive; here we just wait briefly for a complete frame. */
    uint32_t t0 = HAL_GetTick();
    while (!OV5640_GetFrame(&frame) && (HAL_GetTick() - t0) < 2000U)
    {
      sys_check_timeouts();
    }
  }
  else
  {
    frame = NULL;
  }

  if (frame == NULL)
  {
    http_reply_err(c, 503, "Service Unavailable");
    return;
  }

  /* Convert RGB565 -> 24-bit BMP (header + pixels) into bmp_rgb. */
  len = frame_to_bmp(frame, bmp_rgb);

  int n = snprintf(c->resp, sizeof(c->resp),
                   "HTTP/1.1 200 OK\r\n"
                   "Content-Type: image/bmp\r\n"
                   "Content-Length: %lu\r\n"
                   "Cache-Control: no-store\r\n"
                   "Connection: close\r\n"
                   "\r\n",
                   (unsigned long)len);
  c->hdr_len = (size_t)n;
  c->body_ptr = bmp_rgb;
  c->body_len = len;
  /* body_static = 0: conn_send uses TCP_WRITE_FLAG_COPY so the frame is
   * copied into the lwIP send buffer immediately - bmp_rgb is reused. */
  c->body_static = 0;
  c->total_off = 0;
  c->done = 0;
  conn_send(c);
  if (c->done) http_conn_close(c);
}

/* Feed the active stream from the main loop (drop frames if the send
 * buffer is full - the browser just shows the latest). */
void http_stream_poll(void)
{
  const uint8_t *frame;
  uint32_t len;
  char part[64];
  int pn;

  /* Recover a quiet sensor even when nobody is streaming. */
  OV5640_HealthCheck();

  if (g_stream_pcb == NULL || !OV5640_Ready()) return;

  if (!OV5640_GetFrame(&frame)) return;

  /* Only send if the whole part fits, so the buffer never fills. */
  if ((uint32_t)tcp_sndbuf(g_stream_pcb) < BMP_TOT_SIZE + 80U) return;

  /* Convert RGB565 -> 24-bit BMP. */
  len = frame_to_bmp(frame, bmp_rgb);

  pn = snprintf(part, sizeof(part),
                "Content-Type: image/bmp\r\nContent-Length: %lu\r\n\r\n",
                (unsigned long)len);
  if (tcp_write(g_stream_pcb, part, (u16_t)pn, TCP_WRITE_FLAG_COPY) != ERR_OK)
  {
    stream_close();
    return;
  }

  if (tcp_write(g_stream_pcb, bmp_rgb, (u16_t)len, TCP_WRITE_FLAG_COPY) != ERR_OK)
  {
    stream_close();
    return;
  }

  if (tcp_write(g_stream_pcb, "\r\n--" STREAM_BOUNDARY "\r\n",
                (u16_t)(sizeof("\r\n--" STREAM_BOUNDARY "\r\n") - 1),
                TCP_WRITE_FLAG_COPY) != ERR_OK)
  {
    stream_close();
    return;
  }
  tcp_output(g_stream_pcb);
}

static void api_info(struct http_conn *c)
{
  char body[512];
  char lan[16];

  ip4addr_ntoa_r(netif_ip4_addr(&gnetif), lan, sizeof(lan));
  int n = snprintf(body, sizeof(body),
                   "{\"arch\":\"cortex-m4\",\"lan_ip\":\"%s\",\"public_ip\":null,"
                   "\"geo\":null,\"weather\":null,\"ts\":%lu}",
                   lan, (unsigned long)HAL_GetTick());
  http_reply_json(c, body);
}

static void serve_public(struct http_conn *c, const char *path)
{
  for (unsigned i = 0; i < embedded_files_count; i++)
  {
    if (strcmp(path, embedded_files[i].path) == 0)
    {
      http_reply_static(c, embedded_files[i].ctype, NULL,
                        embedded_files[i].data, embedded_files[i].len);
      return;
    }
  }
  http_reply_err(c, 404, "Not Found");
}

static void process_request(struct http_conn *c)
{
  char method[8], path[1024];
  const char *body;

  if (sscanf(c->rx, "%7s %1023s", method, path) != 2)
  {
    http_reply_err(c, 400, "Bad Request");
    return;
  }
  {
    char *q = strchr(path, '?');
    if (q) *q = 0;
  }
  body = strstr(c->rx, "\r\n\r\n");
  body = body ? body + 4 : NULL;

  if (strcmp(path, "/") == 0 || strcmp(path, "/index.html") == 0)
  {
    http_reply_static(c, "text/html; charset=utf-8",
                      "Content-Encoding: gzip\r\n",
                      index_html_gz, index_html_gz_len);
  }
  else if (strcmp(path, "/api/leds") == 0)
  {
    api_leds(c, method, body);
  }
  else if (strcmp(path, "/api/adc") == 0)
  {
    api_adc(c);
  }
  else if (strcmp(path, "/api/camera") == 0)
  {
    api_camera(c);
  }
  else if (strcmp(path, "/stream") == 0)
  {
    api_stream(c);
  }
  else if (strcmp(path, "/capture") == 0)
  {
    api_capture(c);
  }
  else if (strcmp(path, "/api/info") == 0)
  {
    api_info(c);
  }
  else if (strcmp(path, "/favicon.ico") == 0)
  {
    http_reply_err(c, 204, "No Content");
  }
  else if (strncmp(path, "/public/", 8) == 0)
  {
    serve_public(c, path);
  }
  else
  {
    http_reply_err(c, 404, "Not Found");
  }
}

/* --------------------------------------------------------------------------
 * lwIP raw TCP callbacks.
 * ------------------------------------------------------------------------ */
static err_t http_recv(void *arg, struct tcp_pcb *pcb, struct pbuf *p, err_t err)
{
  struct http_conn *c = arg;

  if (err != ERR_OK) return ERR_OK;

  if (p == NULL)
  {
    if (c) { c->done = 1; http_conn_close(c); }
    return ERR_OK;
  }

  if (c)
  {
    if (c->rx_len + p->tot_len < sizeof(c->rx))
    {
      pbuf_copy_partial(p, c->rx + c->rx_len, p->tot_len, 0);
      c->rx_len += p->tot_len;
    }
    tcp_recved(pcb, p->tot_len);

    c->rx[c->rx_len] = 0;
    {
      char *hdr_end = strstr(c->rx, "\r\n\r\n");
      if (hdr_end)
      {
        long cl = 0;
        const char *clh = strstr(c->rx, "Content-Length:");
        if (clh)
        {
          clh += 15;
          while (*clh == ' ') clh++;
          cl = atol(clh);
        }
        {
          size_t want = (size_t)(hdr_end - c->rx) + 4 + (size_t)cl;
          if (c->rx_len >= want)
          {
            c->rx[want] = 0;
            process_request(c);
          }
        }
      }
    }
  }
  pbuf_free(p);
  return ERR_OK;
}

static err_t http_sent(void *arg, struct tcp_pcb *pcb, u16_t len)
{
  struct http_conn *c = arg;
  LWIP_UNUSED_ARG(pcb);
  LWIP_UNUSED_ARG(len);

  if (!c) return ERR_OK;
  if (c->done)
  {
    http_conn_close(c);
  }
  else
  {
    conn_send(c);
  }
  return ERR_OK;
}

static void http_err(void *arg, err_t err)
{
  struct http_conn *c = arg;
  LWIP_UNUSED_ARG(err);
  if (c) mem_free(c);
}

static err_t http_accept(void *arg, struct tcp_pcb *newpcb, err_t err)
{
  struct http_conn *c;
  LWIP_UNUSED_ARG(arg);

  if (err != ERR_OK || newpcb == NULL) return ERR_VAL;

  c = (struct http_conn *)mem_malloc(sizeof(*c));
  if (!c) return ERR_MEM;
  memset(c, 0, sizeof(*c));
  c->pcb = newpcb;

  tcp_arg(newpcb, c);
  tcp_recv(newpcb, http_recv);
  tcp_sent(newpcb, http_sent);
  tcp_err(newpcb, http_err);
  return ERR_OK;
}

/* --------------------------------------------------------------------------
 * Server entry point.
 *
 * http_server_hw_init(): on-board hardware used by the API (LED + sensors).
 *   No network dependency - safe to call at boot.
 * http_server_start():    bind the TCP listener. Call ONLY after the netif
 *   has an IP (DHCP bound or static fallback) - the DHCP state machine in
 *   app_ethernet.c invokes it.
 * ------------------------------------------------------------------------ */
/* Boot-time camera check: waits ~2.5 s for DCMI/DMA to deliver JPEG
 * frames and reports frame size/rate. No network needed. */
static void camera_selftest(void)
{
  OV5640_Selftest();
}

void http_server_hw_init(void)
{
  leds_init();
  led_set(0, 0);
  sensors_init();
  if (OV5640_Init() == 0)
  {
    printf("OV5640: ready (QVGA 320x240 JPEG)\r\n");
    camera_selftest();
  }
  else
  {
    printf("OV5640: not detected (check SCCB/camera)\r\n");
  }
}

void http_server_start(void)
{
  struct tcp_pcb *pcb;

  pcb = tcp_new();
  if (!pcb) return;
  if (tcp_bind(pcb, IP_ADDR_ANY, 80) != ERR_OK) return;
  pcb = tcp_listen(pcb);
  if (!pcb) return;
  tcp_accept(pcb, http_accept);

  printf("HTTP server listening on :80\r\n");
}